/*
 * Copyright (c) 2022 The ZMK Contributors
 *
 * SPDX-License-Identifier: MIT
 */

#include "fulcrum34.dtsi"

&kscan0 {
    col-gpios
        = <&gpio0 25 (GPIO_PULL_DOWN | GPIO_ACTIVE_HIGH)>
        , <&gpio0 24 (GPIO_PULL_DOWN | GPIO_ACTIVE_HIGH)>
        , <&gpio0 15 (GPIO_PULL_DOWN | GPIO_ACTIVE_HIGH)>
        , <&gpio0 13 (GPIO_PULL_DOWN | GPIO_ACTIVE_HIGH)>
        , <&gpio0 14 (GPIO_PULL_DOWN | GPIO_ACTIVE_HIGH)>
        ;
};


