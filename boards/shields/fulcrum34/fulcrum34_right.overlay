/*
 * Copyright (c) 2022 The ZMK Contributors
 *
 * SPDX-License-Identifier: MIT
 */

#include "fulcrum34.dtsi"

&default_transform {
    col-offset = <5>;
};

&kscan0 {
	col-gpios
        = <&gpio0 14 GPIO_ACTIVE_HIGH>
        , <&gpio0 13 GPIO_ACTIVE_HIGH>
        , <&gpio0 15 GPIO_ACTIVE_HIGH>
        , <&gpio0 24 GPIO_ACTIVE_HIGH>
        , <&gpio0 25 GPIO_ACTIVE_HIGH>
        ;
};

