## boards/adafruit/feather_nrf52840/nrf52840/zmk/Kconfig.defconfig
```kconfig
# Adafruit Feather nRF52840 Express board configuration

# Copyright (c) 2020 Tobias Svehagen
# Copyright (c) 2024 Jacob Winther
# SPDX-License-Identifier: Apache-2.0

if BOARD_ADAFRUIT_FEATHER_NRF52840_NRF52840_ZMK

choice ZMK_BOOTMODE_MAGIC_VALUE_BOOTLOADER_TYPE
    default ZMK_BOOTMODE_MAGIC_VALUE_BOOTLOADER_TYPE_ADAFRUIT_NRF52

endchoice

endif # BOARD_ADAFRUIT_FEATHER_NRF52840_NRF52840_ZMK
```

## boards/adafruit/feather_nrf52840/nrf52840/zmk/board.yml
```yaml
board:
  name: adafruit_feather_nrf52840
  full_name: Feather nRF52840 (Express, Sense)
  vendor: adafruit
  socs:
    - name: nrf52840
      variants:
        - name: zmk
```

## boards/shields/fulcrum34/Kconfig.defconfig
```kconfig
# Copyright (c) 2024 The ZMK Contributors
# SPDX-License-Identifier: MIT

if SHIELD_FULCRUM34_RIGHT

config ZMK_KEYBOARD_NAME
    default "Fulcrum34"

config ZMK_SPLIT_ROLE_CENTRAL
    default y
	
config ZMK_SPLIT_BLE_CENTRAL_BATTERY_LEVEL_FETCHING
	default y
	
config ZMK_SPLIT_BLE_CENTRAL_BATTERY_LEVEL_PROXY
	default y

endif # SHIELD_FULCRUM34_RIGHT

if SHIELD_FULCRUM34_LEFT || SHIELD_FULCRUM34_RIGHT

config ZMK_SPLIT
    default y

config ZMK_BOARD_COMPAT
    default y

endif # SHIELD_FULCRUM34_LEFT || SHIELD_FULCRUM34_RIGHT
```

## boards/shields/fulcrum34/Kconfig.shield
```kconfig
# Copyright (c) 2024 The ZMK Contributors
# SPDX-License-Identifier: MIT

config SHIELD_FULCRUM34_LEFT
    def_bool $(shields_list_contains,fulcrum34_left)

config SHIELD_FULCRUM34_RIGHT
    def_bool $(shields_list_contains,fulcrum34_right)
```

## config/west.yml
```yaml
manifest:
  remotes:
    - name: zmkfirmware
      url-base: https://github.com/zmkfirmware
#    - name: n-shastensis
#      url-base: https://github.com/N-shastensis
    # Additional modules containing boards/shields/custom code can be listed here as well
    # See https://docs.zephyrproject.org/3.2.0/develop/west/manifest.html#projects
  projects:
    - name: zmk
      remote: zmkfirmware
      revision: main
      import: app/west.yml
#    - name: fulcrum34-shield-module
#      remote: n-shastensis
#      revision: main
  self:
    path: config
```
